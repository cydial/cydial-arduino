#include <LiquidCrystal_I2C.h>
// int latitude;
// LiquidCrystal_I2C lcd(0x27,16,2);

int cnt = 0;
#define SCK 13
#define DIN 11
#define LATCH 10

#define TEXTBUFFERLENGTH 40
#define MODULESIZE 4 /* Module Number */
#define SCROLLSPEED 70
// #define STRING "Test"
String STRING = "DEBUGMODE";

String string = STRING; /* Input String to Display */
int stringLength; /* string 의 문자열 길이를 저장하는 변수 */

uint8_t stringBuff[TEXTBUFFERLENGTH][8]; /* String Dot Data Buffer*/
uint8_t displayBuff[MODULESIZE][8]; /* Display Data Buffer */

boolean scrollFlag = false; /* string 변수가 5글자 이상일 경우 인지 판단하는 flag */
int scrollTIme = SCROLLSPEED; /* 스크롤 속도 조정 */

/* Reference : https://github.com/dhepper/font8x8/blob/master/font8x8_basic.h */
const uint8_t font[128][8] PROGMEM = {
    { 0x00, 0x00, 0x00, 0x00, 0x00, 0x00, 0x00, 0x00},   // U+0000 (nul)
    { 0x00, 0x00, 0x00, 0x00, 0x00, 0x00, 0x00, 0x00},   // U+0001
    { 0x00, 0x00, 0x00, 0x00, 0x00, 0x00, 0x00, 0x00},   // U+0002
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    { 0x00, 0x00, 0x00, 0x00, 0x00, 0x00, 0x00, 0x00}    // U+007F
};

void setup() {
  // put your setup code here, to run once:
  Serial.begin(9600);
  pinMode(SCK, OUTPUT);
  pinMode(DIN, OUTPUT);
  pinMode(LATCH, OUTPUT);

  // lcd.init();  // LCD초기 설정             
  // lcd.backlight(); // LCD초기 설정  
  // lcd.setCursor(0,0); //텍스트가 LCD에 나타날 위치
  // lcd.print("Cydial 1.0"); 
  // lcd.setCursor(0,1);
  // lcd.print("Ready To Connect"); 

  Serial.println("Ready");

  write_Max7219(0x09, 0x00); // Decode Mode - No decode for digits
  write_Max7219(0x0a, 0x01); // Intensity - 1/32
  write_Max7219(0x0b, 0x07); // Scan Limit - All Output Port Enable
  write_Max7219(0x0c, 0x01); // Shutdown - Normal Operation
  write_Max7219(0x0f, 0x00); // Display Test
  reset_StringBuff(); // string에 저장된 문자열을 stringBuff에 저장
}

typedef struct LightSensor{
  int time;
  int value;
} LightSensor;
int i=0;
int maxindex = 0;
int maxindex2 = 0;

void loop() {
  // put your main code here, to run repeatedly:
  const bool DEBUG_MODE = true;
  const int DEBUG_INTERVAL = 200;
  LightSensor L[] = {
    {7, 1024 - analogRead(A5)},
    {8, 1024 - analogRead(A4)},
    {9, 1024 - analogRead(A3)},
    {10, 1024 - analogRead(A2)},
    {11, 1024 - analogRead(A1)},
    {12, 1024 - analogRead(A0)}
  };
  LightSensor R[] = {
    {12, 1024 - analogRead(A14)},
    {13, 1024 - analogRead(A13)},
    {14, 1024 - analogRead(A12)},
    {15, 1024 - analogRead(A11)},
    {16, 1024 - analogRead(A10)},
    {17, 1024 - analogRead(A9)}
  };
  if (DEBUG_MODE){
    cnt++;
    Serial.print("-----");
    Serial.print(cnt);
    Serial.print("-----\n");
    Serial.println("[[L12-Left]]");
    Serial.println(L[6].value);
    Serial.println("[[L11]]");
    Serial.println(L[5].value);
    Serial.println("[[L10]]");
    Serial.println(L[4].value);
    Serial.println("[[L9]]");
    Serial.println(L[3].value);
    Serial.println("[[L8]]");
    Serial.println(L[2].value);
    Serial.println("[[L7]]");
    Serial.println(L[1].value);
    Serial.println("[[L6]]");
    Serial.println(L[0].value);
    Serial.println("-----");
    Serial.println("[[L18]]");
    Serial.println(R[6].value);;
    Serial.println("[[L17]]");
    Serial.println(R[5].value);
    Serial.println("[[L16]]");
    Serial.println(R[4].value);
    Serial.println("[[L15]]");
    Serial.println(R[3].value);
    Serial.println("[[L14]]");
    Serial.println(R[2].value);
    Serial.println("[[L13]]");
    Serial.println(R[1].value);
    Serial.println("[[L12-Right]]");
    Serial.println(R[0].value);
    delay(DEBUG_INTERVAL);
  }
  for(i=0; i<=6; i++)
  {
      if(L[maxindex].value <= L[i].value)
      {
          maxindex = i;
      }
  }
  for(i=0; i<=6; i++)
  {
      if(R[maxindex2].value <= R[i].value)
      {
          maxindex2 = i;
      }
  }
  int maxtime = (L[maxindex].value>=R[maxindex2].value)?L[maxindex].time:R[maxindex2].time;
  // if (L[maxindex].time == 12 || R[maxindex2].time == 12) maxtime = 12;
  Serial.println(maxtime);
  switch(maxtime){
    case 7:
      string = "AM07";
      break;
    case 8:
      string = "AM08";
      break;
    case 9:
      string = "AM09";
      break;
    case 10:
      string = "AM10";
      break;
    case 11:
      string = "AM11";
      break;
    case 12:
      string = "PM12";
      break;
    case 13:
      string = "PM01";
      break;
    case 14:
      string = "PM02";
      break;
    case 15:
      string = "PM03";
      break;
    case 16:
      string = "PM04";
      break;
    case 17:
      string = "PM05";
      break;
    default:
      string = "ERROR";
      break;
  }
  Serial.println(string);
  reset_StringBuff(); // string에 저장된 문자열을 stringBuff에 저장
  Serial.print("\nLeft max Time: ");
  Serial.print(L[maxindex].time);
  Serial.print(" / value: ");
  Serial.print(L[maxindex].value);
  Serial.print("\nRight max Time: ");
  Serial.print(R[maxindex2].time);
  Serial.print(" / value: ");
  Serial.print(R[maxindex2].value);
  unsigned long now = millis();
  static unsigned long pastTime;

  if(now-pastTime >= scrollTIme){ // 설정된 스크롤 간격으로 동작하는 if문
      if(scrollFlag){
          pastTime = now;
          static int index;
          static int shiftCount;
          for(int i = 0 ; i < MODULESIZE ; i++){
              for(int j = 0 ; j < 8 ; j++){
                  displayBuff[i][j] = (stringBuff[index+i][j] >> shiftCount) | stringBuff[index+i+1][j] << 8 - shiftCount;
              }
          }
          shiftCount++;
          if(shiftCount == 8){
              shiftCount = 0;
          }
          if(index > stringLength + 5){
              index = 0;
          }
          display_Max7219();
      }
    }
  delay(DEBUG_INTERVAL);
}

void write_Max7219(uint8_t address, uint8_t data){
    digitalWrite(LATCH,LOW);
    for(int i = 0 ; i < MODULESIZE ; i++){
        shiftOut(DIN, SCK, MSBFIRST, address);
        shiftOut(DIN, SCK, MSBFIRST, data);
    }
    digitalWrite(LATCH,HIGH);
}

void display_Max7219(){
    for( int rowNumber = 1 ; rowNumber < 9 ; rowNumber++){
        digitalWrite(LATCH,LOW);
        for( int columnData = 0 ; columnData < MODULESIZE ; columnData++){
            shiftOut(DIN, SCK, MSBFIRST, rowNumber);
            shiftOut(DIN, SCK, LSBFIRST, displayBuff[columnData][rowNumber - 1]);
        }
        digitalWrite(LATCH,HIGH);
    }
}

void reset_StringBuff(){ // stringBuff에 데이터 세팅하는 함수
    stringLength = string.length();
    for(int i = 0 ; i < TEXTBUFFERLENGTH ; i++){
        for(int j = 0 ; j < 8 ; j++){
            stringBuff[i][j] = 0b00;
        }
    }
    if(stringLength > 4){
        scrollFlag = true;
        for(int i = 5 ; i < stringLength + 5 ; i++){
            for(int j = 0 ; j < 8 ; j++){
                stringBuff[i][j] = pgm_read_byte(&(font[string.charAt(i-5)][j]));
            }
        }
    }
    else{
        scrollFlag = false;
        for(int i = 0 ; i < stringLength ; i++){
            for(int j = 0 ; j < 8 ; j++){
                displayBuff[i][j] = pgm_read_byte(&(font[string.charAt(i)][j]));
            }
        }
        display_Max7219();
    }
}
